## config/snippets/nice-view-spi-setup/Kconfig.snippet
```kconfig
config ZMK_SNIPPET_NICE_VIEW_SPI_SETUP
	bool "Define nice_view_spi node"
	help
	  Define the nice_view_spi devicetree node that nice_view.overlay expects.
	  Must be loaded before nice_view.overlay.
```
