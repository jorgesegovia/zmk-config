/*
 * Add-on shield: full-duplex wired UART split transport.
 *
 * Stacked on top of the lily58_left / lily58_right shields, e.g.
 *   shield: lily58_left wired
 *
 * Uses the Pro-Micro interconnect's predefined UART (&pro_micro_serial),
 * available on both nice_nano_v2 and mikoto. Full-duplex requires both
 * data conductors (TX/RX) routed through the TRRS connector.
 */

&pro_micro_serial {
    status = "okay";
};

/ {
    wired_split {
        compatible = "zmk,wired-split";
        device = <&pro_micro_serial>;
    };
};

/*
 * NOTE: this shield only enables the wired UART transport. The nice!view CS
 * relocation for the full-duplex revision lives in the separate `nvcs_d4`
 * shield, so the display fix applies to BOTH the wired and wireless builds.
 *
 * This ZMK build compiles BOTH BLE and wired split (wired priority 0, BLE 1),
 * but automatic wired->BLE fallback only works when the wired-split node has a
 * `detect-gpios` cable-detect pin. The current boards have none, so this is
 * wired-only; add `detect-gpios` on a revision with a TRRS-detect pin to make
 * a single firmware fall back to BLE.
 */
